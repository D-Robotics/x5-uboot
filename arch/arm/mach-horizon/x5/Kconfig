## arch/arm/mach-horizon/x5/Kconfig
```kconfig
if X5

config SYS_BOARD
	default "x5"

config SYS_VENDOR
	default "horizon"

config SYS_SOC
	default "x5"

config SYS_CONFIG_NAME
	default "x5"

endif
```

## board/horizon/x5/x5-aarch32.its
```
/*
 * Compilation:
 * mkimage -f fit_kernel_dtb.its fit_kernel_dtb.itb
 *
 */

/dts-v1/;
/ {
	description = "U-Boot FIT for x5";
	#address-cells = <1>;

	images {
		kernel {
			description = "Linux kernel";
			data = /incbin/("zImage");
			type = "kernel";
			arch = "arm";
			os = "linux";
			compression = "none";
			load = <0x90008000>;
			entry = <0x90008000>;
			/*
			hash-1 {
				algo = "sha1";
			};
			*/
		};

		fdt {
			description = "FDT";
			data = /incbin/("x5.dtb");
			type = "flat_dt";
			arch = "arm";
			compression = "none";
			hash-1 {
				algo = "sha1";
			};
		};
	};

	configurations {
		default = "vbd";

		vbd {
			description = "x5";
			kernel = "kernel";
			fdt = "fdt";
		};
	};
};
```

## board/horizon/x5/x5.its
```
/*
 * Compilation:
 * mkimage -f fit_kernel_dtb.its fit_kernel_dtb.itb
 *
 */

/dts-v1/;
/ {
	description = "U-Boot FIT for x5";
	#address-cells = <1>;

	images {
		kernel {
			description = "Linux kernel";
			data = /incbin/("Image");
			type = "kernel";
			arch = "arm64";
			os = "linux";
			compression = "none";
			load = <0xc0008000>;
			entry = <0xc0008000>;
			/*
			hash-1 {
				algo = "sha1";
			};
			*/
		};

		fdt {
			description = "FDT";
			data = /incbin/("x5.dtb");
			type = "flat_dt";
			arch = "arm64";
			compression = "none";
			hash-1 {
				algo = "sha1";
			};
		};
	};

	configurations {
		default = "vbd";

		vbd {
			description = "x5";
			kernel = "kernel";
			fdt = "fdt";
		};
	};
};
```

## configs/hobot_x5_auto_defconfig
```kconfig
CONFIG_ARM=y
CONFIG_COUNTER_FREQUENCY=24000000
CONFIG_POSITION_INDEPENDENT=y
CONFIG_ARCH_HORIZON=y
CONFIG_SYS_TEXT_BASE=0x8FEC7000
CONFIG_SYS_MALLOC_LEN=0x4000000
CONFIG_TARGET_X5=y
CONFIG_DROBOT_DISABLE_WDT=y
CONFIG_ENV_SIZE=0x100000
CONFIG_ENV_OFFSET=0x887000
CONFIG_DM_GPIO=y
CONFIG_DEFAULT_DEVICE_TREE="hobot-x5"
CONFIG_SYS_PROMPT="Hobot>"
CONFIG_SYS_LOAD_ADDR=0x90000000
CONFIG_SYS_MEMTEST_START=0x86000000
CONFIG_SYS_MEMTEST_END=0x100000000
CONFIG_WERROR=y
CONFIG_CC_OPTIMIZE_FOR_DEBUG=y
CONFIG_FIT=y
CONFIG_OF_BOARD_SETUP=y
CONFIG_BOOTSTAGE=y
CONFIG_BOOTSTAGE_REPORT=y
CONFIG_BOOTSTAGE_RECORD_COUNT=64
CONFIG_BOOTSTAGE_FDT=y
CONFIG_BOOTSTAGE_RECORD_BOARD_INIT_F=y
CONFIG_BOOTSTAGE_RECORD_BOARD_INIT_R=y
CONFIG_USE_PREBOOT=y
CONFIG_CONSOLE_RECORD=y
CONFIG_CONSOLE_RECORD_OUT_SIZE=0x2000
CONFIG_EVENT=y
CONFIG_EVENT_DYNAMIC=y
CONFIG_BOARD_EARLY_INIT_R=y
CONFIG_LAST_STAGE_INIT=y
CONFIG_AVB_VERIFY=y
CONFIG_AVB_BUF_ADDR=0xA0000000
CONFIG_AVB_BUF_SIZE=0x2000000
CONFIG_AVB_VERIFY_MTD=y
CONFIG_AVB_VERIFY_BLK=y
CONFIG_ANDROID_AB=y
CONFIG_MEMDUMP=y
CONFIG_HUSH_PARSER=y
CONFIG_CMD_MEMTEST=y
CONFIG_CMD_ADC=y
CONFIG_CMD_DFU=y
CONFIG_CMD_DM=y
CONFIG_CMD_GPT=y
CONFIG_CMD_GPT_RENAME=y
CONFIG_CMD_GPT_EXTEND=y
CONFIG_CMD_MMC=y
CONFIG_CMD_MTD=y
CONFIG_CMD_PART=y
CONFIG_CMD_SF=y
CONFIG_CMD_SF_TEST=y
CONFIG_CMD_SPI=y
CONFIG_CMD_USB=y
CONFIG_CMD_USB_MASS_STORAGE=y
CONFIG_CMD_AB_SELECT=y
CONFIG_CMD_DHCP=y
CONFIG_CMD_MII=y
CONFIG_CMD_PING=y
CONFIG_CMD_CACHE=y
CONFIG_CMD_BOOTSTAGE=y
CONFIG_CMD_EXT2=y
CONFIG_CMD_EXT4=y
CONFIG_CMD_EXT4_WRITE=y
CONFIG_CMD_FAT=y
CONFIG_CMD_MTDPARTS=y
CONFIG_CMD_LOG=y
CONFIG_CMD_AVB=y
CONFIG_CMD_MEMDUMP=y
CONFIG_CMD_UBI=y
CONFIG_CMD_UBI_RENAME=y
CONFIG_PARTITION_TYPE_GUID=y
CONFIG_OF_CONTROL=y
CONFIG_ENV_IS_IN_MMC=y
CONFIG_NET_RETRY_COUNT=20
CONFIG_NET_RANDOM_ETHADDR=y
CONFIG_DM=y
CONFIG_DM_EVENT=y
CONFIG_REGMAP=y
CONFIG_SYSCON=y
CONFIG_GUC_ADC=y
CONFIG_CLK=y
CONFIG_DFU_MMC=y
CONFIG_DFU_RAM=y
CONFIG_DFU_VIRT=y
CONFIG_SET_DFU_ALT_INFO=y
CONFIG_USB_FUNCTION_FASTBOOT=y
CONFIG_UDP_FUNCTION_FASTBOOT=y
CONFIG_FASTBOOT_BUF_ADDR=0x90000000
CONFIG_FASTBOOT_FLASH=y
CONFIG_FASTBOOT_FLASH_MMC=y
CONFIG_FASTBOOT_FLASH_SPINAND=y
CONFIG_FASTBOOT_FLASH_RAM=y
CONFIG_FASTBOOT_FLASH_MMC_DEV=0
CONFIG_FASTBOOT_CMD_OEM_RAMDUMP=y
CONFIG_DM_I2C=y
CONFIG_DM_KEYBOARD=y
CONFIG_MISC=y
CONFIG_SUPPORT_EMMC_RPMB=y
CONFIG_SUPPORT_EMMC_BOOT=y
CONFIG_MMC_HS200_SUPPORT=y
CONFIG_MMC_SDHCI=y
CONFIG_MMC_SDHCI_SDMA=y
CONFIG_MMC_SDHCI_X5=y
CONFIG_MTD=y
CONFIG_DM_MTD=y
CONFIG_MTD_SPI_NAND=y
CONFIG_SPI_FLASH=y
CONFIG_SF_DEFAULT_SPEED=50000000
CONFIG_SPI_FLASH_BAR=y
CONFIG_SPI_FLASH_GIGADEVICE=y
CONFIG_SPI_FLASH_ISSI=y
CONFIG_SPI_FLASH_WINBOND=y
# CONFIG_SPI_FLASH_USE_4K_SECTORS is not set
CONFIG_SPI_FLASH_MTD=y
CONFIG_PHY_REALTEK=y
CONFIG_DM_MDIO=y
CONFIG_DWC_ETH_QOS=y
CONFIG_DWC_ETH_QOS_STM32=y
CONFIG_RGMII=y
CONFIG_PINCTRL=y
CONFIG_PINCTRL_HORIZON=y
CONFIG_DM_REGULATOR=y
CONFIG_DM_REGULATOR_FIXED=y
CONFIG_SPECIFY_CONSOLE_INDEX=y
CONFIG_DM_SERIAL=y
CONFIG_SYS_NS16550=y
CONFIG_PL01X_SERIAL=y
CONFIG_SPI=y
CONFIG_DM_SPI=y
CONFIG_DESIGNWARE_SPI=y
CONFIG_TEE=y
CONFIG_OPTEE=y
# CONFIG_OPTEE_TA_AVB is not set
CONFIG_USB=y
CONFIG_DM_USB_GADGET=y
CONFIG_USB_XHCI_HCD=y
CONFIG_USB_XHCI_DWC3=y
CONFIG_USB_XHCI_DWC3_OF_SIMPLE=y
CONFIG_USB_DWC3=y
CONFIG_USB_DWC3_GENERIC=y
CONFIG_USB_STORAGE=y
CONFIG_USB_HOST_ETHER=y
CONFIG_USB_ETHER_ASIX=y
CONFIG_USB_ETHER_ASIX88179=y
CONFIG_USB_ETHER_RTL8152=y
CONFIG_USB_GADGET=y
CONFIG_USB_GADGET_VENDOR_NUM=0x3652
CONFIG_USB_GADGET_PRODUCT_NUM=0x0530
CONFIG_DESIGNWARE_WATCHDOG=y
CONFIG_WDT=y
CONFIG_HOBOT_BOARD_TYPE=y
CONFIG_HOBOT_ADC_BTYPE=y
CONFIG_FAT_WRITE=y
CONFIG_LIBAVB=y
# CONFIG_EFI_LOADER is not set
```

## configs/horizon_x5_defconfig
```kconfig
CONFIG_ARM=y
CONFIG_COUNTER_FREQUENCY=24000000
CONFIG_POSITION_INDEPENDENT=y
CONFIG_ARCH_HORIZON=y
CONFIG_SYS_TEXT_BASE=0x80f00000
CONFIG_X5=y
CONFIG_ENV_SIZE=0x4000
CONFIG_ENV_OFFSET=0xFF0000
CONFIG_ENV_SECT_SIZE=0x1000
CONFIG_DM_GPIO=y
CONFIG_DEFAULT_DEVICE_TREE="x5-fpga"
CONFIG_SYS_LOAD_ADDR=0x88880000
# CONFIG_ARCH_FIXUP_FDT_MEMORY is not set
CONFIG_HUSH_PARSER=y
CONFIG_CMD_ASKENV=y
CONFIG_CMD_DM=y
CONFIG_CMD_GPT=y
CONFIG_CMD_MMC=y
CONFIG_CMD_SF_TEST=y
CONFIG_CMD_SPI=y
CONFIG_CMD_USB=y
CONFIG_CMD_DHCP=y
CONFIG_CMD_MII=y
CONFIG_CMD_PING=y
CONFIG_CMD_FAT=y
CONFIG_OF_CONTROL=y
CONFIG_OF_EMBED=y
CONFIG_ENV_IS_IN_SPI_FLASH=y
CONFIG_NET_RANDOM_ETHADDR=y
CONFIG_DM=y
CONFIG_CLK=y
CONFIG_DM_I2C=y
CONFIG_DM_KEYBOARD=y
CONFIG_SUPPORT_EMMC_RPMB=y
CONFIG_SUPPORT_EMMC_BOOT=y
CONFIG_MMC_HS200_SUPPORT=y
CONFIG_MMC_SDHCI=y
CONFIG_MMC_SDHCI_SDMA=y
CONFIG_DM_SPI_FLASH=y
CONFIG_SF_DEFAULT_SPEED=50000000
CONFIG_SPI_FLASH_BAR=y
CONFIG_SPI_FLASH_WINBOND=y
CONFIG_PHY_REALTEK=y
CONFIG_DM_MDIO=y
CONFIG_DWC_ETH_QOS=y
CONFIG_DWC_ETH_QOS_STM32=y
CONFIG_RGMII=y
CONFIG_SPECIFY_CONSOLE_INDEX=y
CONFIG_DM_SERIAL=y
CONFIG_SYS_NS16550=y
CONFIG_PL01X_SERIAL=y
CONFIG_SPI=y
CONFIG_DM_SPI=y
CONFIG_DESIGNWARE_SPI=y
CONFIG_USB=y
CONFIG_USB_XHCI_HCD=y
CONFIG_USB_XHCI_DWC3=y
CONFIG_USB_DWC2=y
CONFIG_USB_STORAGE=y
CONFIG_USB_HOST_ETHER=y
CONFIG_USB_ETHER_ASIX=y
CONFIG_USB_ETHER_ASIX88179=y
CONFIG_USB_ETHER_RTL8152=y
CONFIG_DESIGNWARE_WATCHDOG=y
CONFIG_WDT=y
```

## configs/horizon_x5_mini_defconfig
```kconfig
CONFIG_ARM=y
CONFIG_COUNTER_FREQUENCY=24000000
CONFIG_POSITION_INDEPENDENT=y
CONFIG_ARCH_HORIZON=y
CONFIG_SYS_TEXT_BASE=0x87000000
CONFIG_TARGET_X5=y
CONFIG_DM_GPIO=y
CONFIG_DEFAULT_DEVICE_TREE="hobot-x5"
CONFIG_SYS_LOAD_ADDR=0x8a000000
CONFIG_FIT=y
# CONFIG_ARCH_FIXUP_FDT_MEMORY is not set
CONFIG_HUSH_PARSER=y
CONFIG_CMD_DM=y
CONFIG_CMD_GPT=y
CONFIG_CMD_MMC=y
CONFIG_CMD_MTD=y
CONFIG_CMD_DHCP=y
CONFIG_CMD_MII=y
CONFIG_CMD_PING=y
CONFIG_CMD_FAT=y
CONFIG_OF_CONTROL=y
CONFIG_OF_EMBED=y
CONFIG_NET_RETRY_COUNT=20
CONFIG_NET_RANDOM_ETHADDR=y
CONFIG_DM=y
CONFIG_CLK=y
CONFIG_DM_I2C=y
CONFIG_DM_KEYBOARD=y
CONFIG_MISC=y
CONFIG_SUPPORT_EMMC_RPMB=y
CONFIG_SUPPORT_EMMC_BOOT=y
CONFIG_MMC_HS200_SUPPORT=y
CONFIG_MMC_SDHCI=y
CONFIG_MMC_SDHCI_SDMA=y
CONFIG_MMC_SDHCI_X5=y
CONFIG_MTD=y
CONFIG_DM_MTD=y
CONFIG_SPECIFY_CONSOLE_INDEX=y
CONFIG_DM_SERIAL=y
CONFIG_SYS_NS16550=y
CONFIG_PL01X_SERIAL=y
CONFIG_HOBOT_BOARD_TYPE=y
```

## drivers/pinctrl/horizon/Kconfig
```kconfig
# SPDX-License-Identifier: GPL-2.0
config PINCTRL_HORIZON
	bool "horizon pinctrl driver"
    depends on ARCH_HORIZON && PINCTRL_FULL
	help
	  Say Y here to enable the horizon pinctrl driver
```
