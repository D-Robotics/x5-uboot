## arch/arm/mach-horizon/Kconfig
```kconfig
if ARCH_HORIZON

config TARGET_X5
	bool "Horizon X5 SOC"
	help
	  Support for the Horizon X5 SoC.

config DROBOT_DISABLE_WDT
	bool "Drobot disable watchdog"
	depends on WDT
	help
	  Support disable watchdog in drobotic X5 SOC.

config DROBOT_OPTEE_RPMB_DEBUG_CMD
	bool "enable x5  rpmb optee cmd 'x5_rpmb'"
	help
	  Support debug optee rpmb witch cmd x5_rpmb.

config DROBOT_BOOT_KEY_IN_RPMB
	bool "boot key is in rpmb"
	help
	  Support save boot key in rpmb in drobotic X5 SOC.

config DROBOT_RECORD_UBOOT_RESET
	bool "record uboot reset reason"
	default y
	help
	  Support save boot key in rpmb in drobotic X5 SOC.

config HOBOT_TEST_IN_SRAM
	bool "Enable SRAM test"
	depends on TARGET_X5
	help
	  Enable SRAM memory test during DRAM initialization.
	  This will copy a test binary into SRAM and execute it
	  to verify DDR functionality.

source "arch/arm/mach-horizon/x5/Kconfig"

endif
```

## configs/hobot_x5_quickstart_defconfig
```kconfig
CONFIG_ARM=y
CONFIG_COUNTER_FREQUENCY=24000000
CONFIG_POSITION_INDEPENDENT=y
CONFIG_ARCH_HORIZON=y
CONFIG_SYS_TEXT_BASE=0x8FEC7000
CONFIG_SYS_MALLOC_LEN=0x4000000
CONFIG_TARGET_X5=y
CONFIG_DROBOT_DISABLE_WDT=y
CONFIG_ENV_SIZE=0x30000
CONFIG_ENV_OFFSET=0x0
CONFIG_DM_GPIO=y
CONFIG_DEFAULT_DEVICE_TREE="hobot-x5"
CONFIG_SYS_PROMPT="Hobot>"
CONFIG_SYS_LOAD_ADDR=0x90000000
CONFIG_WERROR=y
CONFIG_CC_OPTIMIZE_FOR_SPEED=y
CONFIG_QUICKSTART=y
CONFIG_QUICKSTART_ABORT_DELAY_MS=80
CONFIG_FIT=y
CONFIG_FIT_CIPHER=y
# CONFIG_FIT_PRINT is not set
CONFIG_OF_BOARD_SETUP=y
# CONFIG_DISPLAY_BOARDINFO is not set
CONFIG_EVENT=y
CONFIG_EVENT_DYNAMIC=y
CONFIG_BOARD_EARLY_INIT_R=y
CONFIG_LAST_STAGE_INIT=y
CONFIG_AVB_VERIFY=y
CONFIG_AVB_BUF_ADDR=0xA0000000
CONFIG_AVB_BUF_SIZE=0x2000000
CONFIG_AVB_VERIFY_BLK=y
CONFIG_ANDROID_AB=y
CONFIG_MEMDUMP=y
CONFIG_HUSH_PARSER=y
# CONFIG_CMD_BDI is not set
# CONFIG_CMD_CONSOLE is not set
# CONFIG_CMD_BOOTD is not set
# CONFIG_CMD_BOOTFLOW is not set
# CONFIG_CMD_BOOTI is not set
# CONFIG_BOOTM_NETBSD is not set
# CONFIG_BOOTM_PLAN9 is not set
# CONFIG_BOOTM_RTEMS is not set
# CONFIG_BOOTM_VXWORKS is not set
# CONFIG_CMD_ELF is not set
# CONFIG_CMD_XIMG is not set
# CONFIG_CMD_RANDOM is not set
CONFIG_CMD_LZMADEC=y
CONFIG_CMD_UNLZ4=y
CONFIG_CMD_UNZIP=y
CONFIG_CMD_DFU=y
CONFIG_CMD_DM=y
CONFIG_CMD_GPT=y
CONFIG_CMD_GPT_RENAME=y
CONFIG_CMD_GPT_EXTEND=y
CONFIG_CMD_MMC=y
CONFIG_CMD_PART=y
CONFIG_CMD_POWEROFF=y
CONFIG_CMD_SPI=y
CONFIG_CMD_USB=y
CONFIG_CMD_AB_SELECT=y
CONFIG_CMD_CACHE=y
CONFIG_CMD_EXT2=y
CONFIG_CMD_EXT4=y
CONFIG_CMD_EXT4_WRITE=y
CONFIG_CMD_FAT=y
CONFIG_CMD_AVB=y
CONFIG_PARTITION_TYPE_GUID=y
CONFIG_OF_CONTROL=y
CONFIG_ENV_OVERWRITE=y
CONFIG_ENV_IS_IN_MMC=y
# CONFIG_NET is not set
CONFIG_DM=y
CONFIG_DM_EVENT=y
CONFIG_REGMAP=y
CONFIG_SYSCON=y
CONFIG_ADC=y
CONFIG_CLK=y
CONFIG_DFU_MMC=y
CONFIG_DFU_RAM=y
CONFIG_DFU_VIRT=y
CONFIG_SET_DFU_ALT_INFO=y
CONFIG_USB_FUNCTION_FASTBOOT=y
CONFIG_FASTBOOT_BUF_ADDR=0x90000000
CONFIG_FASTBOOT_FLASH=y
CONFIG_FASTBOOT_FLASH_MMC=y
CONFIG_FASTBOOT_FLASH_RAM=y
CONFIG_FASTBOOT_FETCH=y
CONFIG_FASTBOOT_FLASH_MMC_DEV=0
CONFIG_FASTBOOT_MMC_USER_SUPPORT=y
CONFIG_FASTBOOT_CMD_OEM_SET_MEDIUM=y
CONFIG_FASTBOOT_CMD_FLASHING_LOCK=y
CONFIG_DWAPB_GPIO=y
# CONFIG_I2C is not set
CONFIG_MISC=y
CONFIG_SUPPORT_EMMC_RPMB=y
CONFIG_SUPPORT_EMMC_BOOT=y
CONFIG_MMC_HS200_SUPPORT=y
CONFIG_MMC_SDHCI=y
CONFIG_MMC_SDHCI_ADMA=y
CONFIG_MMC_SDHCI_X5=y
CONFIG_DM_REGULATOR=y
CONFIG_DM_REGULATOR_FIXED=y
CONFIG_SPECIFY_CONSOLE_INDEX=y
CONFIG_DM_SERIAL=y
CONFIG_SYS_NS16550=y
CONFIG_PL01X_SERIAL=y
CONFIG_SPI=y
CONFIG_DM_SPI=y
CONFIG_SPI_MEM=y
CONFIG_DESIGNWARE_SPI=y
CONFIG_TEE=y
CONFIG_OPTEE=y
# CONFIG_OPTEE_TA_AVB is not set
CONFIG_USB=y
CONFIG_DM_USB_GADGET=y
CONFIG_USB_XHCI_HCD=y
CONFIG_USB_XHCI_DWC3=y
CONFIG_USB_XHCI_DWC3_OF_SIMPLE=y
CONFIG_USB_DWC3=y
CONFIG_USB_DWC3_GENERIC=y
CONFIG_USB_GADGET=y
CONFIG_USB_GADGET_VENDOR_NUM=0x3652
CONFIG_USB_GADGET_PRODUCT_NUM=0x0530
CONFIG_USB_FUNCTION_MASS_STORAGE=y
CONFIG_DESIGNWARE_WATCHDOG=y
CONFIG_WDT=y
CONFIG_FAT_WRITE=y
CONFIG_REGEX=y
CONFIG_LIBAVB=y
CONFIG_LZO=y
CONFIG_GETOPT=y
CONFIG_OF_LIBFDT_OVERLAY=y
# CONFIG_EFI_LOADER is not set
```

## drivers/horizon/Kconfig
```kconfig
menu "Horizon SOC drivers"

config HOBOT_BOARD_TYPE
	bool "Horizon Board Type"
	depends on ARCH_HORIZON
	help
	  Select the board type for your target platform.
	  If unsure, leave the default value.

choice
	prompt "Select Horizon Board Type"
	depends on HOBOT_BOARD_TYPE
	default HOBOT_X5_SOC

config HOBOT_ADC_BTYPE
	bool "ADC_BTYPE"
	select ADC
	help
	  Setup board_type according to adc value.

config HOBOT_X5_SOC
	bool "X5SOC"
	help
	  Select this option for Board Type X5 SOC.

config HOBOT_X5_FPGA
	bool "X5FPGA"
	help
	  Select this option for Board Type X5 FPGA.

config HOBOT_X5_SVB
	bool "X5SVB"
	help
	  Select this option for forcing Board Type X5 SVB.
	  Select HOBOT_ADC_BTYPE when uncertain.

config HOBOT_X5_EVB_LP4_1_A
	bool "X5-EVB_LP4-1_A"
	help
	  Select this option for forcing Board Type X5 LP4 EVB 1_A.
	  Select HOBOT_ADC_BTYPE when uncertain.

config HOBOT_X5_EVB_LP4_1_B
	bool "X5-EVB_LP4-1_B"
	help
	  Select this option for forcing Board Type X5 LP4 EVB 1_B.
	  Select HOBOT_ADC_BTYPE when uncertain.

config HOBOT_X5_EVB_LP4_V1P2
	bool "X5-EVB_LP4-V1P2"
	help
	  Select this option for forcing Board Type X5 LP4 EVB V1P2.
	  Select HOBOT_ADC_BTYPE when uncertain.

config HOBOT_X5_EVB_LP4_V1P3
	bool "X5-EVB_LP4-V1P3"
	help
	  Select this option for forcing Board Type X5 LP4 EVB V1P3.
	  Select HOBOT_ADC_BTYPE when uncertain.

config HOBOT_X5_RDK
	bool "X5RDK"
	help
	  Select this option for Board Type X5 RDK.
	  
config HOBOT_X5_RDK_V1P0
	bool "X5RDK_V1P0"
	help
	  Select this option for Board Type X5 RDK V1P0.

config HOBOT_X5_MD_V0P1_ID
	bool "X5MD_V0P1"
	help
	  Select this option for Board Type X5 MD V0P1.

config HOBOT_X5_MD_V0P2_ID
bool "X5MD_V0P2"
help
Select this option for Board Type X5 MD V0P2.

config HOBOT_X5_MD_V0P3_ID
bool "X5MD_V0P3"
help
Select this option for Board Type X5 MD V0P3.

config HOBOT_X5_MD_V1P0_ID
bool "X5MD_V1P0"
help
Select this option for Board Type X5 MD V1P0.

config HOBOT_X5_MD_V1P1_ID
bool "X5MD_V1P1"
help
Select this option for Board Type X5 MD V1P1.

endchoice

endmenu
```

## drivers/video/d-robotics/Kconfig
```kconfig
config X5_SEAMLESS_DISPLAY
	bool "Enable X5 seamless display"
	select DM_VIDEO
	select VIDEO_DROBOTICS
	select BOARD_LATE_INIT
	select BMP_16BPP
	select BMP_24BPP
	select BMP_32BPP
	select DM_GPIO
	select DM_I2C
	select VIDEO_DW_MIPI_DSI
	select DM_PWM
	select PWM_HOBOT_LPWM
	select BACKLIGHT_PWM
	select SYS_WHITE_ON_BLACK
	select VIDEO_X5_BOOT_UI
	help
	  Enable the D-Robotics X5 display stack in U-Boot: DC8000, DSI
	  host, panel and HDMI bridge drivers, backlight, and seamless
	  framebuffer handoff to Linux (FDT memory reservation, /chosen
	  d-robotics,seamless-display-state, and board env hooks).

	  When disabled, no indented options below are available and the
	  d-robotics display drivers are not linked.

	  Boot-time UI is always enabled with this option. U-Boot brings
	  up the display from board_late_init(): by default a splash logo
	  is shown and standard I/O stays on the serial port only. Set
	  environment variable x5_boot_ui to console for a framebuffer
	  text console on serial and vidconsole (CONSOLE_RECORD replay
	  when enabled). If x5_boot_ui is unset or empty, board code sets
	  it to logo. Only the value console selects framebuffer console;
	  any other value is treated as logo. Kernel boot arguments follow
	  the same variable: logo mode uses console=<uart> and
	  fbcon=map:1; console mode adds console=tty0 before the UART
	  console for early framebuffer output while keeping /dev/console
	  on serial.

config VIDEO_X5_PANEL_DSI
	bool "X5 Generic DSI Panel Support"
	depends on X5_SEAMLESS_DISPLAY
	default y
	help
	  Generic DSI panel drivers for the X5 platform. Enable one or
	  more panel drivers below and pick a build-time default when
	  environment variable x5_lcd_panel is unset.

config X5_PANEL_JC050HD134
	bool "JC-050HD134 (720x1280, 4 lanes) for X5 EVB"
	depends on VIDEO_X5_PANEL_DSI
	default y
	help
	  Enable the JC-050HD134 LCD panel driver (Himax HX8394-F).
	  Resolution: 720x1280, MIPI DSI 4 lanes. Enable for EVB / unified
	  images; runtime selection follows Device Tree compatible.

config X5_PANEL_WH_CM480
	bool "WH-CM480 (DSI; multi-mode timing table)"
	depends on VIDEO_X5_PANEL_DSI
	default y
	help
	  Enable U-Boot DSI timings for compatible "wh-cm480".
	  Default mode matches kernel drivers/gpu/drm/panel/panel-wh-cm480.c
	  (800x480, 1 lane).

config X5_PANEL_ST77031
	bool "ST77031 (600x1280, 2 lanes) for RDK Module"
	depends on VIDEO_X5_PANEL_DSI
	default y
	help
	  Enable the ST77031 LCD panel driver. Resolution: 600x1280,
	  MIPI DSI 2 lanes. Enable for RDK/MD / unified images; runtime
	  selection follows Device Tree compatible.

choice
	prompt "Default LCD panel when env x5_lcd_panel is unset"
	depends on VIDEO_X5_PANEL_DSI
	default X5_DEFAULT_LCD_JC050 if X5_PANEL_JC050HD134
	default X5_DEFAULT_LCD_WH480 if !X5_PANEL_JC050HD134 && X5_PANEL_WH_CM480
	default X5_DEFAULT_LCD_ST77031 if !X5_PANEL_JC050HD134 && !X5_PANEL_WH_CM480 && X5_PANEL_ST77031
	help
	  Build-time default equivalent to setenv x5_lcd_panel <alias>.
	  Used only when U-Boot environment variable x5_lcd_panel is unset
	  or empty. Runtime setenv x5_lcd_panel still overrides this.
	  After that, selection continues with DT x5,default-panel on the
	  slot node, legacy compatible match, then first compiled driver.

config X5_DEFAULT_LCD_JC050
	bool "jc050 (JC-050HD134)"
	depends on X5_PANEL_JC050HD134

config X5_DEFAULT_LCD_WH480
	bool "wh480 (WH-CM480)"
	depends on X5_PANEL_WH_CM480

config X5_DEFAULT_LCD_ST77031
	bool "st77031"
	depends on X5_PANEL_ST77031

endchoice

config VIDEO_X5_HDMI
	bool "X5 HDMI Output Support (via BT1120)"
	depends on X5_SEAMLESS_DISPLAY
	select I2C_EDID
	default y
	help
	  Enable HDMI output support for X5 platform.
	  X5 outputs HDMI through the BT1120 IP (YUV422 parallel)
	  connected to an external HDMI transmitter chip via I2C.
	  Supports up to 4K@30fps.

config X5_HDMI_BRIDGE_LT8618
	bool "Lontium LT8618 HDMI bridge"
	depends on VIDEO_X5_HDMI
	default y
	help
	  Link the LT8618 driver (EDID via LT8618, pattern boot, default bridge).

config X5_HDMI_BRIDGE_SII9022
	bool "Silicon Image SII9022 HDMI bridge"
	depends on VIDEO_X5_HDMI
	default y
	help
	  Link the SII902x driver. At least one of LT8618 / SII9022 should stay
	  enabled for boards using that transmitter.

config VIDEO_X5_HDMI_PATTERN_BOOT
	bool "Boot with LT8618 internal HDMI color-bar pattern (debug)"
	depends on VIDEO_X5_HDMI && X5_HDMI_BRIDGE_LT8618
	default n
	help
	  At x5_display_enable(), skip DC8000 and BT1120; output 1920x1080
	  color bars from the LT8618 internal generator only. Use to verify
	  TMDS timing and the panel/bridge independent of SoC pixel pipe.
	  Disable for one boot with env: x5_hdmi_pattern=0
	  When this option is off, enable the same path with: x5_hdmi_pattern=1

config VIDEO_X5_BOOT_UI
	bool
	depends on X5_SEAMLESS_DISPLAY
	select VIDEO_LOGO
	select CONSOLE_MUX
	select SYS_CONSOLE_IS_IN_ENV

config VIDEO_DROBOTICS
	bool
	help
	  Internal symbol: D-Robotics X5 video drivers under
	  drivers/video/d-robotics/. Selected by X5_SEAMLESS_DISPLAY.
```
